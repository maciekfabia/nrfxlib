## zboss/Kconfig
```kconfig
#
# Copyright (c) 2020 Nordic Semiconductor
#
# SPDX-License-Identifier: LicenseRef-BSD-5-Clause-Nordic
#

menu "ZBOSS stack configuration."

if ZIGBEE

# Add a menu option to switch between compiled libraries and source code.
choice
	prompt "ZBOSS library type"
	default ZBOSS_LIBRARY_PRECOMPILED

config ZBOSS_LIBRARY_PRECOMPILED
	bool "Libraries"
	help
	  Use ZBOSS compiled libraries while building Zigbee application

config ZBOSS_LIBRARY_SOURCES
	bool "Source code"
	help
	  Use ZBOSS source code while building Zigbee application

endchoice

rsource "Kconfig.sources"

endif # ZIGBEE

endmenu
```

## zboss/Kconfig.sources
```kconfig
#
# Copyright (c) 2020 Nordic Semiconductor
#
# SPDX-License-Identifier: LicenseRef-BSD-5-Clause-Nordic
#
# This file defines options, that are used to set configurable entries of zb_vendor.h and zb_config.h platform files.
# It will be used only if ZBOSS source code is available.

menu "ZBOSS features"
	visible if ZBOSS_LIBRARY_SOURCES

config ZB_NVRAM_ENABLE_VER_MIGRATION
	bool "NVRAM migration"
	default y
	help
	  Include procedures to migrate legacy NVRAM structures

config ZB_BDB_ENABLE_FINDING_BINDING
	bool "Finding and Binding"
	default y
	help
	  Enable finding and binding, as defined in BDB specification

config ZB_DISTRIBUTED_SECURITY_ON
	bool "Distributed security"
	default y
	help
	  Enable forming and joining Zigbee networks with distributed security

config ZB_SECURITY_INSTALLCODES
	bool "Install codes"
	default y
	help
	  Enable commissioning with install codes

config ZB_PRODUCTION_CONFIG
	bool "Production configuration"
	default y
	help
	  Enable production configuration

config ZB_APS_USER_PAYLOAD
	bool "APS user frames"
	default y
	help
	  Include API to send raw APS frames

config ZB_LOW_SECURITY_MODE
	bool "NWK security API"
	default y
	help
	  Include API to disable NWK security

config ZB_APS_FRAGMENTATION
	bool "APS fragmentation"
	default y
	help
	  Enable APS fragmentation inside ZBOSS

config ZB_NWK_BLACKLIST
	bool "PAN ID blacklist"
	default y
	help
	  Enable PAN ID blacklisting during rejoin

config ZB_NWK_BLACKLIST_SIZE
	prompt "PAN ID blacklist length" if ZB_NWK_BLACKLIST
	int
	range 1 255
	default 16

config ZB_ZCL_SUPPORT_CLUSTER_WWAH
	bool "WWAH cluster"
	default y
	help
	  Include Works With All Hubs cluster

config ZB_ZCL_ENABLE_WWAH_CLIENT
	bool "WWAHu client"
	depends on ZB_ZCL_SUPPORT_CLUSTER_WWAH
	default y
	help
	  Include WWAHu cluster client implementation

config ZB_ZCL_ENABLE_WWAH_SERVER
	bool "WWAHu server"
	depends on ZB_ZCL_SUPPORT_CLUSTER_WWAH
	default y
	help
	  Include WWAHu cluster server implementation

config ZB_NWK_RETRY_COUNT
	bool "NWK retransmissions"
	depends on ZB_ZCL_ENABLE_WWAH_SERVER
	default y
	help
	  Enable retransmissions on NWK layer

config ZB_BEACON_SURVEY
	bool "Beacon survey"
	depends on ZB_ZCL_ENABLE_WWAH_SERVER
	default y
	help
	  Enable beacon survey

config ZB_PARENT_CLASSIFICATION
	bool "Parent classification"
	depends on ZB_ZCL_ENABLE_WWAH_SERVER
	default y
	help
	  Enable parent classification

endmenu


menu "ZBOSS advanced options"
	visible if ZBOSS_LIBRARY_SOURCES

config ZB_CHECK_OOM_STATUS
	bool "Check for Out Of Memory state"
	help
	  If Zigbee packet buffer pool is in OOM state for a period, specified by ZB_OOM_THRESHOLD,
	  then assertion is triggered.

config ZB_SEND_OOM_STATUS
	bool "Generate NWK status frame in OOM"
	depends on ZB_CHECK_OOM_STATUS
	help
	  Send broadcast frame once OOM state is detected.

config ZB_BDB_TOUCHLINK
	bool "Touchlink commissioning (experimental)"

config ZB_CERTIFICATION_HACKS
	bool "Certification specific behavior"
	help
	  Enable behaviors specific to golden devices used during certification

config ZB_TEST_PROFILE
	bool "Enable Zigbee profile, used by verification framework"

config ZB_MULTITEST_CONSOLE_SLEEP_TIMEOUT
	int "Serial console RX timeout"
	default 4000000

config ZB_DONT_NEED_TRACE_FILE_ID
	bool "Disable TRACE_FILE_ID assert"
	default y
	help
	  Disable sanity check for ZB_TRACE_FILE_ID macro definition in each file

config ZB_MAC_AUTO_DELAY_IN_MAC_GP_SEND
	bool "Enable busy loop in GP implementation"
	help
	  While communicating with Green Power device, ZBOSS will wait before issuing
	  mcps-data.req in a busy loop instead of using MAC features

config ZB_USEALIAS
	bool "NWK requests with aliases"
	help
	  Enables making NWK requests with aliases (see sec. 3.2.1.1.1) or R21 Zigbee PRO specification)

config ZB_LIMIT_VISIBILITY
	bool "MAC filtering"
	help
	  Enables filtering frames at MAC level, based on device's short or long address

endmenu


menu "ZBOSS memory footprint configuration"
	visible if ZBOSS_LIBRARY_SOURCES

config ZB_PANID_TABLE_SIZE
	int "PAN ID translation table size"
	default 28
	help
	  NWK: size of the long-short Pan ID translation table

	  Must be <= (packet buffer size - sizeof(*discovery_confirm)) / sizeof(*network_descriptor)
	  That value limits number of Pan IDs visible for device during active scan.

config ZB_DEV_MANUFACTURER_TABLE_SIZE
	int "long addresses compression table size"
	default 32
	help
	  Size of table used for long addresses compression: 3 bytes of manufacturer id.

	  ZBOSS implements long address compression: 3 bytes of manufacturer
	  id are stored in the separate table; reference to manufacturer
	  entry is stored in the long address giving 2 bytes economy.

	  That is an absolute limit of number of manufacturers known to the device.

	  Note: All that machinery will not work if instead of legal
	  manufacturer ids (or illegal, but fixed ids) use random values.

config ZB_BUF_Q_SIZE
	int "Packet buffer wait queue size"
	default 8
	help
	  Size of queue for wait for free packet buffer

	  Note: To prevent deadlocks ZB_BUF_Q_SIZE must be < ZB_IOBUF_POOL_SIZE/2 */

config ZB_ZDO_TRAN_TABLE_SIZE
	int "ZDO transactions table size"
	default 16

config ZB_APS_ENDPOINTS_IN_GROUP_TABLE
	int "number of endpoints per APS group table entry"
	default 8

config ZB_NWK_BTR_TABLE_SIZE
	int "Broadcast transaction record table size"
	default 16
	help
	  See Zigbee Specification subclause 3.6.5

config ZB_NWK_BRR_TABLE_SIZE
	int "Broadcast Retransmission table size"
	default 16

config ZB_MAX_EP_NUMBER
	int "Number of endpoints"
	default 6
	help
	  Maximum number of supported endpoints per device

config ZB_APS_GROUP_TABLE_SIZE
	int "Number of supported APS groups"
	default 16 if ZIGBEE_ROLE_COORDINATOR || ZIGBEE_ROLE_ROUTER
	default 8 if ZIGBEE_ROLE_END_DEVICE

config ZB_ZGP_SINK_TBL_SIZE
	int "Green Power Sink table size"
	default 24

config ZB_ZGP_PROXY_TBL_SIZE
	int "Green Power Proxy table size"
	default 5


config ZB_CONFIGURABLE_MEM
	bool "Dynamic memory configuration"
	default y
	help
	  Enable dynamic memory configuration feature that allows to change memory
	  footprint if application uses ZBOSS binaries

config ZB_CONFIG_OVERALL_NETWORK_SIZE
	int "Expected overall network size"
	range 2 200
	depends on ZB_CONFIGURABLE_MEM
	default 128

choice ZB_CONFIG_TRAFFIC
	prompt "Expected Zigbee traffic intensity"
	depends on ZB_CONFIGURABLE_MEM

config ZB_CONFIG_HIGH_TRAFFIC
	bool "high"

config ZB_CONFIG_MODERATE_TRAFFIC
	bool "moderate"

config ZB_CONFIG_LIGHT_TRAFFIC
	bool "light"

endchoice

choice ZB_CONFIG_APPLICATION
	prompt "Expected Zigbee application complexity"
	depends on ZB_CONFIGURABLE_MEM

config ZB_CONFIG_APPLICATION_COMPLEX
	bool "complex"

config ZB_CONFIG_APPLICATION_MODERATE
	bool "moderate"

config ZB_CONFIG_APPLICATION_SIMPLE
	bool "simple"

endchoice

config ZB_APS_SRC_BINDING_TABLE_SIZE
	int "Source APS binding table size"
	depends on !ZB_CONFIGURABLE_MEM
	default 16 if ZIGBEE_ROLE_COORDINATOR || ZIGBEE_ROLE_ROUTER
	default 8 if ZIGBEE_ROLE_END_DEVICE

config ZB_APS_DST_BINDING_TABLE_SIZE
	int "Destination APS binding table size"
	depends on !ZB_CONFIGURABLE_MEM
	default 32 if ZIGBEE_ROLE_COORDINATOR || ZIGBEE_ROLE_ROUTER
	default 16 if ZIGBEE_ROLE_END_DEVICE

config ZB_IOBUF_POOL_SIZE
	int "Number of packet buffers"
	depends on !ZB_CONFIGURABLE_MEM
	default 40

config ZB_SCHEDULER_Q_SIZE
	int "Packet buffer wait queue size"
	range 16 32
	depends on !ZB_CONFIGURABLE_MEM
	default 30 if ZIGBEE_ROLE_COORDINATOR || ZIGBEE_ROLE_ROUTER
	default 16 if ZIGBEE_ROLE_END_DEVICE
	help
	  Scheduler callbacks queue size

endmenu
```
